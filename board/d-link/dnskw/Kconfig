## board/d-link/dnskw/Kconfig
```kconfig
if TARGET_DNSKW

config SYS_CPU
	string
	default "arm926ejs"

config SYS_BOARD
	string
	default "dnskw"

config SYS_VENDOR
	string
	default "d-link"

config SYS_SOC
	string
	default "kirkwood"

config SYS_CONFIG_NAME
	string
	default "dnskw"

endif
```
